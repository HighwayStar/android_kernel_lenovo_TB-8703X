/* Copyright (c) 2014, The Linux Foundation. All rights reserved.
 *
 * This program is free software; you can redistribute it and/or modify
 * it under the terms of the GNU General Public License version 2 and
 * only version 2 as published by the Free Software Foundation.
 *
 * This program is distributed in the hope that it will be useful,
 * but WITHOUT ANY WARRANTY; without even the implied warranty of
 * MERCHANTABILITY or FITNESS FOR A PARTICULAR PURPOSE.  See the
 * GNU General Public License for more details.
 */

/*---------------------------------------------------------------------------
 * This file is autogenerated file using gcdb parser. Please do not edit it.
 * Update input XML file to add a new entry or update variable in this file
 * VERSION = "1.0"
 *---------------------------------------------------------------------------*/
&mdss_mdp {
	dsi_innont51021b_1200p_vid: qcom,mdss_dsi_innont51021b_1200p_video {
		qcom,mdss-dsi-panel-name = "innont51021b 1200p video mode dsi panel";
		qcom,mdss-dsi-panel-type = "dsi_video_mode";
		qcom,mdss-dsi-panel-framerate = <60>;
		qcom,mdss-dsi-virtual-channel-id = <0>;
		qcom,mdss-dsi-stream = <0>;
		qcom,mdss-dsi-panel-width = <1200>;
		qcom,mdss-dsi-panel-height = <1920>;
		qcom,mdss-dsi-h-front-porch = <90>;
		qcom,mdss-dsi-h-back-porch = <60>;
		qcom,mdss-dsi-h-pulse-width = <1>;
		qcom,mdss-dsi-h-sync-skew = <0>;
		qcom,mdss-dsi-v-back-porch = <25>;
		qcom,mdss-dsi-v-front-porch = <35>;
		qcom,mdss-dsi-v-pulse-width = <1>;
		qcom,mdss-dsi-h-left-border = <0>;
		qcom,mdss-dsi-h-right-border = <0>;
		qcom,mdss-dsi-v-top-border = <0>;
		qcom,mdss-dsi-v-bottom-border = <0>;
		qcom,mdss-dsi-bpp = <24>;
		qcom,mdss-dsi-underflow-color = <0xff>;
		qcom,mdss-dsi-border-color = <0>;
		qcom,mdss-dsi-on-command = [
			23 01 00 00 05 00 02 8f a5  
			23 01 00 00 14 00 02 01 00  //soft reset
			23 01 00 00 00 00 02 8f a5
			23 01 00 00 00 00 02 83 aa  //page 1
			23 01 00 00 00 00 02 84 11 
			23 01 00 00 00 00 02 a9 4b
			23 01 00 00 00 00 02 83 bb  //page 2
			23 01 00 00 00 00 02 84 22 
			23 01 00 00 00 00 02 96 00  //minimum duty clamp
			23 01 00 00 00 00 02 90 00  //moving mode open
			23 01 00 00 00 00 02 91 80  //close dimming
			23 01 00 00 00 00 02 94 68  //Dimming register control
			23 01 00 00 00 00 02 95 10  //pwm diming off--30 step  10-off
			23 01 00 00 00 00 02 83 00  //page 0
			23 01 00 00 00 00 02 84 00
			23 01 00 00 00 00 02 9f 00  //bkl off
23 01 00 00 00 00 02 8c 04
23 01 00 00 00 00 02 fd 53
23 01 00 00 00 00 02 fa 0e
23 01 00 00 00 00 02 83 AA
23 01 00 00 00 00 02 84 11
23 01 00 00 00 00 02 C0 00
23 01 00 00 00 00 02 C1 02
23 01 00 00 00 00 02 C2 04
23 01 00 00 00 00 02 C3 0c
23 01 00 00 00 00 02 C4 17
23 01 00 00 00 00 02 C5 1e
23 01 00 00 00 00 02 C6 25
23 01 00 00 00 00 02 C7 2b
23 01 00 00 00 00 02 C8 30
23 01 00 00 00 00 02 C9 6e
23 01 00 00 00 00 02 CA 71
23 01 00 00 00 00 02 CB 83
23 01 00 00 00 00 02 CC 8b
23 01 00 00 00 00 02 CD 94
23 01 00 00 00 00 02 CE 91
23 01 00 00 00 00 02 CF 94
23 01 00 00 00 00 02 D0 82
23 01 00 00 00 00 02 D1 77
23 01 00 00 00 00 02 D2 75
23 01 00 00 00 00 02 D3 74
23 01 00 00 00 00 02 D4 66
23 01 00 00 00 00 02 D5 32
23 01 00 00 00 00 02 D6 37
23 01 00 00 00 00 02 D7 3b
23 01 00 00 00 00 02 D8 40
23 01 00 00 00 00 02 D9 44
23 01 00 00 00 00 02 DA 4a
23 01 00 00 00 00 02 DB 4c
23 01 00 00 00 00 02 DC 50
23 01 00 00 00 00 02 DD 54
23 01 00 00 00 00 02 DE 00
23 01 00 00 00 00 02 DF 20
23 01 00 00 00 00 02 E0 26
23 01 00 00 00 00 02 E1 28
23 01 00 00 00 00 02 E2 2a
23 01 00 00 00 00 02 E3 32
23 01 00 00 00 00 02 E4 3d
23 01 00 00 00 00 02 E5 46
23 01 00 00 00 00 02 E6 4b
23 01 00 00 00 00 02 E7 51
23 01 00 00 00 00 02 E8 56
23 01 00 00 00 00 02 E9 B8
23 01 00 00 00 00 02 EA B9
23 01 00 00 00 00 02 EB Ce
23 01 00 00 00 00 02 EC D9
23 01 00 00 00 00 02 ED e0
23 01 00 00 00 00 02 EE De
23 01 00 00 00 00 02 EF e0
23 01 00 00 00 00 02 F0 ce
23 01 00 00 00 00 02 F1 C3
23 01 00 00 00 00 02 F2 C0
23 01 00 00 00 00 02 F3 C1
23 01 00 00 00 00 02 F4 B2
23 01 00 00 00 00 02 F5 4c
23 01 00 00 00 00 02 F6 4f
23 01 00 00 00 00 02 F7 4f
23 01 00 00 00 00 02 F8 50
23 01 00 00 00 00 02 F9 51
23 01 00 00 00 00 02 FA 51
23 01 00 00 00 00 02 FB 52
23 01 00 00 00 00 02 FC 54
23 01 00 00 00 00 02 FD 54
23 01 00 00 00 00 02 FE 00
23 01 00 00 00 00 02 FF 20
23 01 00 00 00 00 02 83 BB
23 01 00 00 00 00 02 84 22
23 01 00 00 00 00 02 C0 00
23 01 00 00 00 00 02 C1 0B
23 01 00 00 00 00 02 C2 14
23 01 00 00 00 00 02 C3 1c
23 01 00 00 00 00 02 C4 24
23 01 00 00 00 00 02 C5 2a
23 01 00 00 00 00 02 C6 30
23 01 00 00 00 00 02 C7 35
23 01 00 00 00 00 02 C8 3a
23 01 00 00 00 00 02 C9 81
23 01 00 00 00 00 02 CA 84
23 01 00 00 00 00 02 CB 95
23 01 00 00 00 00 02 CC A0
23 01 00 00 00 00 02 CD AD
23 01 00 00 00 00 02 CE B0
23 01 00 00 00 00 02 CF B2
23 01 00 00 00 00 02 D0 AD
23 01 00 00 00 00 02 D1 B3
23 01 00 00 00 00 02 D2 BE
23 01 00 00 00 00 02 D3 D0
23 01 00 00 00 00 02 D4 D0
23 01 00 00 00 00 02 D5 6F
23 01 00 00 00 00 02 D6 75
23 01 00 00 00 00 02 D7 7D
23 01 00 00 00 00 02 D8 84
23 01 00 00 00 00 02 D9 8A
23 01 00 00 00 00 02 DA 93
23 01 00 00 00 00 02 DB 9B
23 01 00 00 00 00 02 DC A2
23 01 00 00 00 00 02 DD A9
23 01 00 00 00 00 02 DE 00
23 01 00 00 00 00 02 DF 20
23 01 00 00 00 00 02 E0 26
23 01 00 00 00 00 02 E1 31
23 01 00 00 00 00 02 E2 3A
23 01 00 00 00 00 02 E3 42
23 01 00 00 00 00 02 E4 4A
23 01 00 00 00 00 02 E5 52
23 01 00 00 00 00 02 E6 56
23 01 00 00 00 00 02 E7 5B
23 01 00 00 00 00 02 E8 60
23 01 00 00 00 00 02 E9 CB
23 01 00 00 00 00 02 EA CC
23 01 00 00 00 00 02 EB E0
23 01 00 00 00 00 02 EC EE
23 01 00 00 00 00 02 ED F9
23 01 00 00 00 00 02 EE FD
23 01 00 00 00 00 02 EF FE
23 01 00 00 00 00 02 F0 F9
23 01 00 00 00 00 02 F1 FF
23 01 00 00 00 00 02 F2 09
23 01 00 00 00 00 02 F3 1D
23 01 00 00 00 00 02 F4 1C
23 01 00 00 00 00 02 F5 89
23 01 00 00 00 00 02 F6 8D
23 01 00 00 00 00 02 F7 91
23 01 00 00 00 00 02 F8 94
23 01 00 00 00 00 02 F9 97
23 01 00 00 00 00 02 FA 9A
23 01 00 00 00 00 02 FB A1
23 01 00 00 00 00 02 FC A6
23 01 00 00 00 00 02 FD A9
23 01 00 00 00 00 02 FE 00
23 01 00 00 00 00 02 FF 2E
23 01 00 00 00 00 02 83 CC
23 01 00 00 00 00 02 84 33
23 01 00 00 00 00 02 C0 00
23 01 00 00 00 00 02 C1 05
23 01 00 00 00 00 02 C2 0B
23 01 00 00 00 00 02 C3 16
23 01 00 00 00 00 02 C4 22
23 01 00 00 00 00 02 C5 2B
23 01 00 00 00 00 02 C6 33
23 01 00 00 00 00 02 C7 39
23 01 00 00 00 00 02 C8 3E
23 01 00 00 00 00 02 C9 89
23 01 00 00 00 00 02 CA 8E
23 01 00 00 00 00 02 CB A2
23 01 00 00 00 00 02 CC AD
23 01 00 00 00 00 02 CD B8
23 01 00 00 00 00 02 CE BF
23 01 00 00 00 00 02 CF C2
23 01 00 00 00 00 02 D0 C3
23 01 00 00 00 00 02 D1 D5
23 01 00 00 00 00 02 D2 E9
23 01 00 00 00 00 02 D3 08
23 01 00 00 00 00 02 D4 12
23 01 00 00 00 00 02 D5 98
23 01 00 00 00 00 02 D6 A1
23 01 00 00 00 00 02 D7 AC
23 01 00 00 00 00 02 D8 B7
23 01 00 00 00 00 02 D9 C1
23 01 00 00 00 00 02 DA CF
23 01 00 00 00 00 02 DB DC
23 01 00 00 00 00 02 DC EA
23 01 00 00 00 00 02 DD F8
23 01 00 00 00 00 02 DE 00
23 01 00 00 00 00 02 DF 2C
23 01 00 00 00 00 02 E0 26
23 01 00 00 00 00 02 E1 2B
23 01 00 00 00 00 02 E2 31
23 01 00 00 00 00 02 E3 3C
23 01 00 00 00 00 02 E4 48
23 01 00 00 00 00 02 E5 53
23 01 00 00 00 00 02 E6 59
23 01 00 00 00 00 02 E7 5F
23 01 00 00 00 00 02 E8 64
23 01 00 00 00 00 02 E9 D3
23 01 00 00 00 00 02 EA D6
23 01 00 00 00 00 02 EB ED
23 01 00 00 00 00 02 EC FB
23 01 00 00 00 00 02 ED 04
23 01 00 00 00 00 02 EE 0C
23 01 00 00 00 00 02 EF 0E
23 01 00 00 00 00 02 F0 0F
23 01 00 00 00 00 02 F1 21
23 01 00 00 00 00 02 F2 34
23 01 00 00 00 00 02 F3 55
23 01 00 00 00 00 02 F4 5E
23 01 00 00 00 00 02 F5 B2
23 01 00 00 00 00 02 F6 B9
23 01 00 00 00 00 02 F7 C0
23 01 00 00 00 00 02 F8 C7
23 01 00 00 00 00 02 F9 CE
23 01 00 00 00 00 02 FA D6
23 01 00 00 00 00 02 FB E2
23 01 00 00 00 00 02 FC EE
23 01 00 00 00 00 02 FD F8
23 01 00 00 00 00 02 FE F0
23 01 00 00 00 00 02 FF 2F
		];
		qcom,mdss-dsi-off-command = [
			23 01 00 00 00 00 02 83 00
			23 01 00 00 00 00 02 84 00
		];

		qcom,mdss-dsi-on-command-state = "dsi_lp_mode";
		qcom,mdss-dsi-off-command-state = "dsi_lp_mode";
		//qcom,cont-splash-enabled;
		qcom,mdss-dsi-h-sync-pulse = <1>;
		qcom,mdss-dsi-traffic-mode = "burst_mode";
		qcom,mdss-dsi-bllp-eof-power-mode;
		qcom,mdss-dsi-bllp-power-mode;
		qcom,mdss-dsi-lane-0-state;
		qcom,mdss-dsi-lane-1-state;
		qcom,mdss-dsi-lane-2-state;
		qcom,mdss-dsi-lane-3-state;
		qcom,mdss-dsi-panel-timings = [f2 3a 28 00 6c 70 2c 3e 2e 03 04 00];
		qcom,mdss-dsi-t-clk-post = <0xd>;
		qcom,mdss-dsi-t-clk-pre = <0x30>;
		qcom,mdss-dsi-bl-min-level = <1>;
		qcom,mdss-dsi-bl-max-level = <255>;
		qcom,mdss-dsi-dma-trigger = "trigger_sw";
		qcom,mdss-dsi-mdp-trigger = "none";
		qcom,mdss-dsi-force-clock-lane-hs;
		qcom,platform-bklight-en-gpio = <&tlmm 46 0>;
		qcom,mdss-dsi-lcden-ctrl = <&tlmm 61 0>;
		qcom,mdss-dsi-bl-pmic-control-type = "bl_ctrl_dcs";
		//qcom,mdss-dsi-bl-pmic-pwm-frequency = <100>;
		//qcom,mdss-dsi-bl-pmic-bank-select = <0>;
		//qcom,mdss-dsi-pwm-gpio = <&pm8953_mpps 4 0>;
		//qcom,panel-supply-entries = <&dsi_panel_pwr_supply>;
		qcom,mdss-pan-physical-width-dimension = <108>;
		qcom,mdss-pan-physical-height-dimension = <172>;
	};
};
